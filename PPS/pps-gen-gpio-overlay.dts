/dts-v1/;
/plugin/;
/ {
       compatible = "brcm,bcm2711";
       fragment@0 {
               target-path = "/";
               __overlay__ {
                       pps_gen: pps_gen {
                               compatible = "pps-gen-gpios";
                pps-gen-gpios = <&gpio 17 0>;
                               pinctrl-names = "default";
                               pinctrl-0 = <&pps_pins>;
                               status = "okay";
                       };
               };
       };
       fragment@1 {
               target = <&gpio>;
               __overlay__ {
                       pps_pins: pps_pins {
                               brcm,pins =     <17>;
                               brcm,function = <1>;    // out
                               brcm,pull =     <1>;    // on
                       };
               };
       };
       __overrides__ {
               gpiopin = <&pps_gen>,"gpios:4",
                         <&pps_pins>,"brcm,pins:0";
               assert_falling_edge = <&pps_gen>,"assert-falling-edge?";
       };
};
